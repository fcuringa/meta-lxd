## conf/layer.conf
```bitbake
# We have a conf and classes directory, add to BBPATH
BBPATH .= ":${LAYERDIR}"

# We have recipes-* directories, add to BBFILES
BBFILES += "${LAYERDIR}/recipes-*/*/*.bb \
            ${LAYERDIR}/recipes-*/*/*.bbappend"

BBFILE_COLLECTIONS += "meta-lxd"
BBFILE_PATTERN_meta-lxd = "^${LAYERDIR}/"
BBFILE_PRIORITY_meta-lxd = "6"

LAYERDEPENDS_meta-lxd = "core"
LAYERSERIES_COMPAT_meta-lxd = "gatesgarth"
```
